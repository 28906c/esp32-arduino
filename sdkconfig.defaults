## sdkconfig.defaults
```kconfig
# ===== 目标芯片 =====
CONFIG_IDF_TARGET_ESP32P4=y
CONFIG_IDF_EXPERIMENTAL_FEATURES=y

# ===== CPU 频率 =====
CONFIG_ESP_DEFAULT_CPU_FREQ_MHZ=400

# ===== Flash 16MB =====
CONFIG_ESPTOOLPY_FLASHSIZE_16MB=y
CONFIG_ESPTOOLPY_FLASHSIZE="16MB"
CONFIG_ESPTOOLPY_FLASHFREQ_80M=y
CONFIG_ESPTOOLPY_FLASHMODE_DIO=y

# ===== PSRAM Hex 模式 200MHz =====
CONFIG_SPIRAM=y
CONFIG_SPIRAM_MODE_HEX=y
CONFIG_SPIRAM_SPEED_200M=y
CONFIG_SPIRAM_SPEED=200
CONFIG_SPIRAM_BOOT_INIT=y
CONFIG_SPIRAM_USE_CAPS_ALLOC=y
CONFIG_SPIRAM_IGNORE_NOTFOUND=y
CONFIG_SPIRAM_ALLOW_BSS_SEG_EXTERNAL_MEMORY=y

# ===== 分区表 =====
CONFIG_PARTITION_TABLE_CUSTOM=y
CONFIG_PARTITION_TABLE_CUSTOM_FILENAME="partitions.csv"
CONFIG_PARTITION_TABLE_MD5=y

# ===== 编译优化 =====
CONFIG_COMPILER_OPTIMIZATION_SIZE=y
CONFIG_COMPILER_DISABLE_DEFAULT_ERRORS=y
CONFIG_COMPILER_DISABLE_GCC14_WARNINGS=y

# ===== 日志 =====
CONFIG_LOG_DEFAULT_LEVEL_INFO=y

# ===== FATFS (TF 卡) =====
CONFIG_FATFS_VOLUME_COUNT=1

# ===== LVGL v8.3 字体预启用 =====
CONFIG_LV_FONT_MONTSERRAT_24=y
CONFIG_LV_FONT_MONTSERRAT_32=y
CONFIG_LV_FONT_MONTSERRAT_48=y
CONFIG_LV_USE_FONT_MONTSERRAT_24=y
CONFIG_LV_USE_FONT_MONTSERRAT_32=y
CONFIG_LV_USE_FONT_MONTSERRAT_48=y
CONFIG_LV_FONT_DEFAULT_MONTSERRAT_24=y

# ===== BSP 显示 (M1 启用, M0 预置) =====
CONFIG_BSP_LCD_TYPE_720_1280_5_INCH_A=y
CONFIG_BSP_LCD_COLOR_FORMAT_RGB565=y
CONFIG_BSP_LCD_MIPI_DSI_LANE_BITRATE_MBPS=600
CONFIG_BSP_LCD_DPI_BUFFER_NUMS=3
CONFIG_LVGL_DISP_DEF_REFR_PERIOD=10
CONFIG_LV_DPI_DEF=300

# ===== FreeRTOS 调试 =====
CONFIG_FREERTOS_USE_TRACE_FACILITY=y
CONFIG_FREERTOS_USE_STATS_FORMATTING_FUNCTIONS=y

# ===== 任务看门狗 =====
CONFIG_ESP_TASK_WDT=y
CONFIG_ESP_TASK_WDT_TIMEOUT_S=60
CONFIG_ESP_TASK_WDT_PANIC=y

# ===== mbedTLS AES =====
CONFIG_MBEDTLS_AES_C=y
CONFIG_MBEDTLS_CIPHER_MODE_CBC=y

# ===== 电源管理 =====
CONFIG_PM_ENABLE=y
CONFIG_PM_SLP_DISABLE_GPIO=y
CONFIG_PM_POWER_DOWN_CPU_IN_LIGHT_SLEEP=y
```
